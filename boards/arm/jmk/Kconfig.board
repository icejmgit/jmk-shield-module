## boards/shields/arm/jmk/Kconfig.defconfig
```kconfig
if BOARD_jmk

config ZMK_KEYBOARD_NAME
    default "jmk V1"


if USB

config USB_NRFX
    default y

config USB_DEVICE_STACK
    default y

endif # USB

config BT_CTLR
    default BT

endif # BOARD_jmk
```

## boards/shields/jmk/Kconfig.defconfig
```kconfig
if SHIELD_JMK_LEFT

# Name must be less than 16 characters long!
config ZMK_KEYBOARD_NAME
    default "jmk Keyboard"

config ZMK_SPLIT_ROLE_CENTRAL
    default y

endif

if SHIELD_JMK_LEFT || SHIELD_JMK_RIGHT

config ZMK_SPLIT
    default y

endif
```

## boards/shields/jmk/Kconfig.shield
```kconfig
# No whitespace after the comma or in your part name!
config SHIELD_JMK_LEFT
    def_bool $(shields_list_contains,jmk_left)

# No whitespace after the comma or in your part name!
config SHIELD_JMK_RIGHT
    def_bool $(shields_list_contains,jmk_right)
```
